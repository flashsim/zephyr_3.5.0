## soc/arm/nations_n32/n32g45x/Kconfig.defconfig.series
```kconfig
# SPDX-License-Identifier: Apache-2.0

# Kconfig symbols common to n32g45x series





if SOC_SERIES_N32G45

source "soc/arm/nations_n32/n32g45x/Kconfig.defconfig.n32g45x*"

config SOC_SERIES
	default "n32g45x"

config SYS_CLOCK_HW_CYCLES_PER_SEC
	default $(dt_node_int_prop_int,/clocks/clk_sys,clock-frequency)

endif # SOC_SERIES_N32G45
```

## soc/arm/nations_n32/n32g45x/Kconfig.series
```kconfig
# Nationstech N32G45x MCU series

# Copyright (c) 2024
# SPDX-License-Identifier: Apache-2.0

config SOC_SERIES_N32G45
	bool "N32G45 Series MCU"
	select ARM
	select CPU_CORTEX_M4
	select SOC_FAMILY_NATIONS_N32
	help
	  Enable support for N32G45x MCU series.
```

## soc/arm/nations_n32/n32g45x/Kconfig.soc
```kconfig
# SPDX-License-Identifier: Apache-2.0

choice
	prompt "N32G45 MCU Selection"
	depends on SOC_SERIES_N32G45

config SOC_N32G45X
	bool "SOC_N32G45X"

endchoice
```

## west.yml
```yaml
# The west manifest file for upstream Zephyr.
#
# The per-installation west configuration file, .west/config, sets the
# path to the project containing this file in the [manifest] section's
# "path" variable.
#
# You are free to create your own manifest files and put them in any
# repository you want, to create your own custom Zephyr installations.
# For example, you could create a manifest file in your own out of
# tree application directory, which would pull this zephyr repository
# in as an ordinary project.
#
# You can pass your manifest repositories to west init when creating a
# new Zephyr installation. See the west documentation for more
# information.

manifest:
  defaults:
    remote: upstream

  remotes:
    - name: upstream
      url-base: https://github.com/zephyrproject-rtos
    - name: babblesim
      url-base: https://github.com/BabbleSim

    - name: flashsim
      url-base: https://github.com/flashsim

  group-filter: [-babblesim, -flashsim]


  #
  # Please add items below based on alphabetical order
  projects:
 
    - name: hal_ethos_u
      revision: 90ada2ea5681b2a2722a10d2898eac34c2510791
      path: modules/hal/ethos_u
      groups:
        - hal
    - name: hal_gigadevice
      revision: 2994b7dde8b0b0fa9b9c0ccb13474b6a486cddc3
      path: modules/hal/gigadevice
      groups:
        - hal
    - name: hal_infineon
      revision: 815e84a5150f95627201f192779a0180d5052de7
      path: modules/hal/infineon
      groups:
        - hal
    - name: hal_intel
      revision: b3b43d4e3da7ba483611bbbea7ef8af92c69df31
      path: modules/hal/intel
      groups:
        - hal
    - name: hal_microchip
      revision: 5d079f1683a00b801373bbbbf5d181d4e33b30d5
      path: modules/hal/microchip
      groups:
        - hal
    - name: hal_nordic
      revision: d054a315eb888ba70e09e5f6decd4097b0276d1f
      path: modules/hal/nordic
      groups:
        - hal
    - name: hal_nuvoton
      revision: 3e0a4c4d3328b2f72b164219add19d5308b53cb5
      path: modules/hal/nuvoton
      groups:
        - hal
    - name: hal_nxp
      revision: ad142f5612d927e29b1f9606e8edade871b8a526
      path: modules/hal/nxp
      groups:
        - hal
    - name: hal_openisa
      revision: d1e61c0c654d8ca9e73d27fca3a7eb3b7881cb6a
      path: modules/hal/openisa
      groups:
        - hal
    - name: hal_quicklogic
      revision: b3a66fe6d04d87fd1533a5c8de51d0599fcd08d0
      path: modules/hal/quicklogic
      repo-path: hal_quicklogic
      groups:
        - hal
    - name: hal_renesas
      path: modules/hal/renesas
      revision: a6cf2af9140e014fbbc48d2b6deb802231dd369f
      groups:
        - hal
    - name: hal_rpi_pico
      path: modules/hal/rpi_pico
      revision: fba7162cc7bee06d0149622bbcaac4e41062d368
      groups:
        - hal
    - name: hal_silabs
      revision: d191d981c4eb20c0c7445a4061fcdbcfa686113a
      path: modules/hal/silabs
      groups:
        - hal
    - name: hal_st
      revision: fb8e79d1a261fd02aadff7c142729f1954163cf3
      path: modules/hal/st
      groups:
        - hal
    - name: hal_stm32
      revision: 89ef0a3383edebf661073073bcdf6e2836fe90ee
      path: modules/hal/stm32
      groups:
        - hal
    - name: hal_telink
      revision: 38573af589173259801ae6c2b34b7d4c9e626746
      path: modules/hal/telink
      groups:
        - hal
    - name: hal_ti
      revision: b85f86e51fc4d47c4c383d320d64d52d4d371ae4
      path: modules/hal/ti
      groups:
        - hal
    - name: hal_wurthelektronik
      revision: 24ca9873c3d608fad1fea0431836bc8f144c132e
      path: modules/hal/wurthelektronik
      groups:
        - hal
    - name: hal_xtensa
      revision: e6da34fc07dfe96161ab8743f5dbeb6e6307ab93
      path: modules/hal/xtensa
      groups:
        - hal
    - name: libmetal
      revision: b91611a6f47dd29fb24c46e5621e797557f80ec6
      path: modules/hal/libmetal
      groups:
        - hal
    - name: liblc3
      revision: 448f3de31f49a838988a162ef1e23a89ddf2d2ed
      path: modules/lib/liblc3
    - name: littlefs
      path: modules/fs/littlefs
      groups:
        - fs
      revision: ca583fd297ceb48bced3c2548600dc615d67af24
    - name: loramac-node
      revision: 842413c5fb98707eb5f26e619e8e792453877897
      path: modules/lib/loramac-node
    - name: lvgl
      revision: 8a6a2d1d29d17d1e4bdc94c243c146a39d635fdd
      path: modules/lib/gui/lvgl
    - name: mbedtls
      revision: c38dc78d9a8dcbe43b898cc1171ab33ba3e6fc26
      path: modules/crypto/mbedtls
      groups:
        - crypto
    - name: mcuboot
      revision: 13767d0b72eb14ce42eb8aad1e5a133ef66afc54
      path: bootloader/mcuboot
    - name: mipi-sys-t
      path: modules/debug/mipi-sys-t
      groups:
        - debug
      revision: a819419603a2dfcb47f7f39092e1bc112e45d1ef
    - name: net-tools
      revision: d68ee9d17648a1bb3729c2023abfcb735dfe92fa
      path: tools/net-tools
      groups:
        - tools
    - name: hal_nations
      revision: 7d87348240d469afec2d639377c164cec7dd9337
      path: modules/hal/nations
      remote: flashsim
      groups:
        - hal 

  self:
    path: zephyr
    west-commands: scripts/west-commands.yml
    import: submanifests
```
