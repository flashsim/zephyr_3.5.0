## boards/arm/n32g45xv_stb/Kconfig.board
```kconfig
# N32G45XV-STB Development Board

# SPDX-License-Identifier: Apache-2.0

config BOARD_N32G45XV_STB
	bool "NATIONS N32G45XV-STB"
	depends on SOC_N32G45X
```

## boards/arm/n32g45xv_stb/Kconfig.defconfig
```kconfig
# Nations N32G45XV-STB development board configuration

# SPDX-License-Identifier: Apache-2.0

config BOARD
	default "n32g45xv-stb"
	depends on BOARD_N32G45XV-STB
```

## boards/arm/n32g45xv_stb/n32g45xv_stb_defconfig
```kconfig
# SPDX-License-Identifier: Apache-2.0


CONFIG_SOC_SERIES_N32G45=y
CONFIG_SOC_N32G45X=y
CONFIG_BUILD_OUTPUT_HEX=y

# Floating point options
CONFIG_FPU=y

# enable console
CONFIG_CONSOLE=y
CONFIG_UART_CONSOLE=y


# enable uart driver
CONFIG_SERIAL=y

CONFIG_CLOCK_CONTROL=y
CONFIG_CLOCK_CTRL_N32=y
CONFIG_SYS_CLOCK_HW_CYCLES_PER_SEC=24000000

# enable PINCTRL
CONFIG_PINCTRL=y

# enable GPIO
CONFIG_GPIO=y
CONFIG_GPIO_N32=y
```

## drivers/adc/Kconfig.n32
```kconfig
# ADC configuration options
#
# SPDX-License-Identifier: Apache-2.0

config ADC_N32
	bool  "N32 MCU ADC driver"
	default y
    
    select USE_N32_ADC
	select ADC_N32_INTERRUPT
	help
	  Enable ADC support on the N32 family of processors.
      
```

## drivers/can/Kconfig.n32
```kconfig
# ADC configuration options
#
# SPDX-License-Identifier: Apache-2.0

config CAN_N32_BXCAN
	bool  "N32 MCU bxCAN driver"
	default y
    
    select USE_N32_BXCAN
	select CAN_N32_INTERRUPT
	help
	  Enable bxCAN support on the N32 family of processors.
      
      
if CAN_N32_BXCAN

config CAN_MAX_STANDARD_ID_FILTER
	int "Maximum number of standard (11-bit) ID filters"
	default 14
	range 0 28
	

config CAN_MAX_EXTENDED_ID_FILTER
	int "Maximum number of extended (29-bit) ID filters"
	default 7
	range 0 14
	
endif # CAN_N32_BXCAN
```

## drivers/clock_control/Kconfig.n32
```kconfig
# SPDX-License-Identifier: Apache-2.0

menuconfig CLOCK_CTRL_N32
	bool "CLOCK_CTRL Driver for N32 family of MCUs"
	depends on SOC_FAMILY_NATIONS_N32
	select N32_HAL_RCC
	help
	  Enable CLOCK_CTRL driver for N32 MCUs

if CLOCK_CTRL_N32
	
endif # CLOCK_CTRL_N32
```

## drivers/flash/Kconfig.n32
```kconfig
# Copyright (c) 2023, Quincy.W <wangqyfm@foxmail.com>
# SPDX-License-Identifier: Apache-2.0

config SOC_FLASH_N32
	bool "N32 flash driver"
	default y
	depends on FLASH
	select FLASH_HAS_PAGE_LAYOUT
	select FLASH_HAS_DRIVER_ENABLED
	select N32_HAL_FMC
	help
	  Enables N32 driver.
```

## drivers/gpio/Kconfig.n32
```kconfig
# Copyright (c) 2023, Quincy.W <wangqyfm@foxmail.com>
# SPDX-License-Identifier: Apache-2.0

menuconfig GPIO_N32
	bool "GPIO Driver for N32 family of MCUs"
    default y
	depends on SOC_FAMILY_NATIONS_N32
	select N32_HAL_GPIO
	help
	  Enable GPIO driver for N32 MCUs

if GPIO_N32

choice GPIO_N32_SWJ
	prompt "Serial wire JTAG configuration"
	depends on SOC_SERIES_N32F1X

config GPIO_N32_SWJ_ENABLE
	bool "Full SWJ (JTAG-DP + SW-DP): Reset State"

config GPIO_N32_SWJ_NONJTRST
	bool "Full SWJ (JTAG-DP + SW-DP) but without NJTRST"

config GPIO_N32_SWJ_NOJTAG
	bool "JTAG-DP Disabled and SW-DP Enabled"

config GPIO_N32_SWJ_DISABLE
	bool "JTAG-DP Disabled and SW-DP Disabled"

endchoice

endif # GPIO_N32
```

## drivers/i2c/Kconfig.n32
```kconfig
# Copyright (c) 2024
# SPDX-License-Identifier: Apache-2.0




config I2C_N32
	bool "N32 MCU I2C driver"
	default y

	#select USE_N32_I2C
    select I2C_N32_INTERRUPT
	help
	  Enable I2C support on the N32 family of processors.
```

## drivers/serial/Kconfig.n32
```kconfig
# Copyright (c) 2023, Quincy.W <wangqyfm@foxmail.com>
# SPDX-License-Identifier: Apache-2.0

config UART_N32
	bool "N32 MCU uart driver"
	default y
	depends on SERIAL
	depends on SOC_FAMILY_NATIONS_N32
	select SERIAL_HAS_DRIVER
	select N32_HAL_USART
   # select SERIAL_SUPPORT_INTERRUPT
	help
	  This option enables the UART driver for N32 family of processors.
```

## drivers/spi/Kconfig.n32
```kconfig
# Copyright (c) 2024
# SPDX-License-Identifier: Apache-2.0




config SPI_N32
	bool "N32 MCU SPI driver"
	default y

	#select USE_N32_SPI
    select SPI_N32_INTERRUPT
	help
	  Enable I2C support on the N32 family of processors.
      
```

## dts/bindings/adc/nations,n32-adc.yaml
```yaml
# Copyright (c) 2024
# SPDX-License-Identifier: Apache-2.0

description: Nations N32 family ADC

compatible: "nations,n32-adc"

include: [adc-controller.yaml, pinctrl-device.yaml]

properties:
  reg:
    required: true

  clocks:
    required: true

  pinctrl-0:
    type: phandles
    required: false
    description: |
        GPIO pin configuration for ADC input. The phandles are
        expected to reference pinctrl nodes, e.g.
           pinctrl-0 = <&adc1_channel_01_pa0 &adc1_channel_02_pa1>;

  interrupts:
    required: true

  "#io-channel-cells":
    const: 1
      
  pinctrl-names:
    required: true  
      
  channels:
    type: int
    description: Number of external channels
    required: true   

io-channel-cells:
    - input
```

## dts/bindings/can/nations,n32-bxcan.yaml
```yaml
# Copyright 2024, Nationstech
#
# SPDX-License-Identifier: Apache-2.0

description: Nations N32 family bxCAN controller

compatible: "nations,n32-bxcan"

include: ["can-controller.yaml", "pinctrl-device.yaml"]

properties:
  reg:
    required: true

  interrupts:
    required: true

  clocks:
    required: true

  pinctrl-0:
    required: true

  pinctrl-names:
    required: true
```

## dts/bindings/clock/nations,n32-pll-clock.yaml
```yaml
# SPDX-License-Identifier: Apache-2.0

description: Generic fixed-rate clock provider
  
compatible: "nations,n32-pll-clock.yaml"

include: [clock-controller.yaml, base.yaml]

properties:
  "#clock-cells":
    const: 0

  clocks:
    required: true

  mul:
    type: int
    required: true
    description: |
        Main PLL multiplication factor for VCO
        Valid range: 2 - 16
```

## dts/bindings/clock/nations,n32-rcc.yaml
```yaml
# Copyright (c) 2024
# SPDX-License-Identifier: Apache-2.0

description: |
  N32 Reset and Clock controller node.
  This node is in charge of system clock ('SYSCLK') source selection and controlling
  clocks for AHB (Advanced High Performance) and APB (Advanced Peripheral) bus domains.

compatible: "nations,n32-rcc"

include: [clock-controller.yaml, base.yaml]

properties:
    reg:
      required: true

    "#clock-cells":
      const: 1

    clock-frequency:
      required: false
      type: int
      description: |
        default frequency in Hz for clock output

    ahb-prescaler:
      type: int
      required: false
      enum:
        - 1
        - 2
        - 4
        - 8
        - 16
        - 64
        - 128
        - 256
        - 512
      description: AHB prescaler.

    apb1-prescaler:
      type: int
      required: false
      enum:
        - 1
        - 2
        - 4
        - 8
        - 16

    apb2-prescaler:
      type: int
      required: false
      enum:
        - 1
        - 2
        - 4
        - 8
        - 16

clock-cells:
  - bits
```

## dts/bindings/flash_controller/nations,n32-flash-controller.yaml
```yaml
# Copyright (c) 2024
# SPDX-License-Identifier: Apache-2.0

description: Nations N32 Family flash controller

compatible: "nations,n32-flash-controller"

include: flash-controller.yaml
```

## dts/bindings/gpio/nations,n32-gpio.yaml
```yaml
# Copyright (c) 2024
# SPDX-License-Identifier: Apache-2.0

description: Nations N32 family GPIO node

compatible: "nations,n32-gpio"

include: [gpio-controller.yaml, base.yaml]

properties:
    reg:
      required: true

    clocks:
      required: true

    "#gpio-cells":
      const: 2

gpio-cells:
  - pin
  - flags
```

## dts/bindings/i2c/nations,n32-i2c.yaml
```yaml
# Copyright (c) 2024
# SPDX-License-Identifier: Apache-2.0

description: N32 I2C

include: [i2c-controller.yaml, pinctrl-device.yaml]

compatible: "nations,n32-i2c"

properties:
  reg:
    required: true

  pinctrl-0:
    type: phandles
    required: true

  interrupts:
    required: true
      
  pinctrl-names:
    required: true
    
  clocks:
    required: true
```

## dts/bindings/pinctrl/nations,n32g45-pinctrl.yaml
```yaml
# SPDX-License-Identifier: Apache-2.0

description: |
    N32 Pin controller Node

compatible: "nations,n32g45-pinctrl"

include: base.yaml

properties:
  reg:
    required: true

child-binding:
  description: |
      This binding gives a base representation of the N32 pins configration

  include:
    - name: pincfg-node.yaml
      property-allowlist:
        - bias-disable
        - bias-pull-down
        - bias-pull-up
        - drive-push-pull
        - drive-open-drain
        - output-low
        - output-high

  properties:
    pinmux:
      required: true
      type: int
      description: |
        Pin Mux.
        
        
        
    slew-rate:
      type: string
      default: "max-speed-10mhz"
      enum:
        - "max-speed-10mhz"       # Default
        - "max-speed-2mhz"
        - "max-speed-50mhz"
      description: |
        Pin output mode, maximum achievable speed. Only applies to
        output mode (alternate).
        
        
        
```

## dts/bindings/serial/nations,n32-uart.yaml
```yaml
# Copyright (c) 2024
# SPDX-License-Identifier: Apache-2.0

description: N32 UART

compatible: "nations,n32-uart"

include: [uart-controller.yaml, pinctrl-device.yaml]

properties:
    reg:
      required: true

    clocks:
      required: true
```

## dts/bindings/spi/nations,n32-spi.yaml
```yaml
# Copyright (c) 2024
# SPDX-License-Identifier: Apache-2.0

description: N32 SPI controller

compatible: "nations,n32-spi"  

include: [spi-controller.yaml,pinctrl-device.yaml]

properties:
    reg:
      required: true

    interrupts:
      required: true

    pinctrl-0:
      type: phandles
      required: true
      
    pinctrl-names:
      required: true
```

## modules/hal_nations/Kconfig
```kconfig
# nations HAL config

# Copyright (c) 2024 
#
# SPDX-License-Identifier: Apache-2.0
#

config N32_HAS_AF_PINMUX
	bool
	help
	  This option should be selected if the series use an AF pinmux model.

config N32_HAS_AFIO_PINMUX
	bool
	help
	  This option should be selected if the series use an AFIO pinmux model.


config HAS_NATIONS_N32_HAL
	bool
	select HAS_CMSIS_CORE if ARM




if HAS_NATIONS_N32_HAL


choice N32_HXTAL_FREQUENCY
	prompt "High speed external oscillator clock frequency"
    default N32_HXTAL_FIRMWARE_DEFINED
    default N32_HXTAL_8MHZ if SOC_SERIES_N32G45
    help
      Define value of high speed crystal oscillator (HXTAL) in Hz
	  This value sets the frequency of the oscillator.

config N32_HXTAL_FIRMWARE_DEFINED
	bool "Firmware defined"
	help
	  Use default frequency defined in firmware for HXTAL
	  This is using for SoCs (e.g., etc ...)
	  that have default HXTAL definitions in firmware.

config N32_HXTAL_8MHZ
	bool "8MHz"
	help
	  Use 8MHz oscillator for HXTAL

endchoice



config USE_N32_RCC
	bool
	help
	  Enable N32 Reset and Clock Control (RCC) HAL module driver
    default y

config USE_N32_DMA
	bool
	help
	  Enable N32 Direct Memory Access controller (DMA) HAL module driver
    default y

config USE_N32_GPIO
	bool
	default y
	help
	  Enable N32 General-purpose and Alternate-Function I/Os
	  (GPIO and AFIO) HAL module driver


config USE_N32_UART
	bool
	help
	  Enable N32 Universal Synchronous/Asynchronous Receiver/Transmitter
	  (UART) HAL module driver
    default y

config USE_N32_I2C
	bool
    help
	  Enable N32 Inter-Integrated Circuit (I2C) HAL module driver
    default y

config USE_N32_SPI
	bool
    help
	  Enable N32 Inter-Integrated Circuit (SPI) HAL module driver
    default y

config CONFIG_USE_N32_BXCAN
	bool
    help
	  Enable N32 Inter-Integrated Circuit (CAN) HAL module driver
    default y
    
    
config USE_N32_ADC
	bool
    help
	  Enable N32 Inter-Integrated Circuit (ADC) HAL module driver
    default y








endif # HAS_NATIONS_N32_HAL
```

## soc/arm/nations_n32/Kconfig
```kconfig
# Copyright (c) 2024 Nationstech MCU 
#  
# SPDX-License-Identifier: Apache-2.0

config SOC_FAMILY_NATIONS_N32
	bool
    select HAS_NATIONS_N32_HAL
	select HAS_SEGGER_RTT if ZEPHYR_SEGGER_MODULE
	select BUILD_OUTPUT_HEX

if SOC_FAMILY_NATIONS_N32

config SOC_FAMILY
	string
	default "nations_n32"

source "soc/arm/nations_n32/*/Kconfig.soc"

endif # SOC_FAMILY_NATIONS_N32
```

## soc/arm/nations_n32/Kconfig.defconfig
```kconfig
# SPDX-License-Identifier: Apache-2.0

source "soc/arm/nations_n32/*/Kconfig.defconfig.series"
```

## soc/arm/nations_n32/n32g45x/Kconfig.defconfig.n32g45x
```kconfig
# SPDX-License-Identifier: Apache-2.0

if SOC_N32G45X

config SOC
	default "N32G45X"

config NUM_IRQS
	default 86
endif # SOC_N32G45X
```
